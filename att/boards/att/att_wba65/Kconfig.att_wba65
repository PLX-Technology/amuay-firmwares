## att/boards/att/att_wba65/Kconfig.att_wba65
```kconfig
# Copyright (c) 2025 STMicroelectronics
# SPDX-License-Identifier: Apache-2.0

config BOARD_ATT_WBA65
	select SOC_STM32WBA65XX
```

## att/boards/att/att_wba65/Kconfig.defconfig
```kconfig
# STM32WBA65RI Nucleo board configuration

# Copyright (c) 2025 STMicroelectronics

# SPDX-License-Identifier: Apache-2.0

if BOARD_ATT_WBA65

config SPI_STM32_INTERRUPT
	default y
	depends on SPI

endif # BOARD_ATT_WBA65
```

## att/boards/att/att_wba65/board.yml
```yaml
board:
  name: att_wba65
  full_name: ATT Varec2500 (STM32WBA65 + ADIN2111 SPE)
  vendor: adi
  socs:
    - name: stm32wba65xx
```

## field-switch/boards/adi/mfs06/Kconfig.defconfig
```kconfig
# MFS (field switch) board configuration

# Copyright (c) 2024 Analog Devices, Inc.
# SPDX-License-Identifier: Apache-2.0

if BOARD_MFS06

config BOARD
	default "MFS06"

if NETWORKING

config NET_L2_ETHERNET
	default y

endif # NETWORKING

endif # BOARD_MFS06
```

## field-switch/boards/adi/mfs06/board.yml
```yaml
# Copyright (c) 2024 Analog Devices, Inc.
# SPDX-License-Identifier: Apache-2.0

board:
  name: mfs06
  vendor: adi
  socs:
    - name: max32690
```

## power-switch/boards/adi/mps04p/Kconfig.defconfig
```kconfig
# MPS-04P (power switch) board configuration

# Copyright (c) 2024 Analog Devices, Inc.
# SPDX-License-Identifier: Apache-2.0

if BOARD_MPS04P

config BOARD
	default "MPS04P"

if NETWORKING

config NET_L2_ETHERNET
	default y

endif # NETWORKING

endif # BOARD_MPS04P
```

## power-switch/boards/adi/mps04p/board.yml
```yaml
# Copyright (c) 2024 Analog Devices, Inc.
# SPDX-License-Identifier: Apache-2.0

board:
  name: mps04p
  vendor: adi
  socs:
    - name: max32690
```
